## prj.conf
```kconfig
# Display Configurations
CONFIG_DISPLAY=y
CONFIG_DISPLAY_LOG_LEVEL_ERR=y

# Log Configurations
CONFIG_LOG=y
CONFIG_LV_USE_LOG=n

# Shell Configurations
# CONFIG_SHELL=y
# CONFIG_LV_Z_SHELL=y
# CONFIG_PWM_SHELL=y

# LVGL Configurations
CONFIG_LVGL=y
CONFIG_LV_FONT_MONTSERRAT_46=y
CONFIG_LV_FONT_MONTSERRAT_18=y
CONFIG_LV_FONT_MONTSERRAT_16=y
CONFIG_LV_FONT_MONTSERRAT_14=y
CONFIG_LV_FONT_MONTSERRAT_12=y
CONFIG_LV_FONT_MONTSERRAT_10=y
# Important for LVGL to work.
CONFIG_MAIN_STACK_SIZE=8192
# CONFIG_LV_MEM_CUSTOM=y
CONFIG_LV_Z_MEM_POOL_SIZE=65536

# PWM Configurations
CONFIG_PWM=y

# Bluetooth Settings
# Bluetooth Configurations
CONFIG_BT=y
CONFIG_BT_CENTRAL=y
CONFIG_BT_PERIPHERAL=y
CONFIG_BT_DEVICE_NAME="ZephyrWatch"
CONFIG_BT_DEVICE_APPEARANCE=192
CONFIG_BT_GATT_CLIENT=y
CONFIG_BT_GATT_SERVICE_CHANGED=y
CONFIG_BT_CONN_DISABLE_SECURITY=n
CONFIG_BT_SMP_ALLOW_UNAUTH_OVERWRITE=y
CONFIG_BT_GATT_AUTO_DISCOVER_CCC=y
CONFIG_BT_AUTO_PHY_UPDATE=n

# Bluetooth GATT Device Information Service Configuration
CONFIG_BT_DIS=y
CONFIG_BT_DIS_PNP=n
CONFIG_BT_DIS_MODEL="ZephyrWatch"
CONFIG_BT_DIS_MANUF="gyokhan.com"
CONFIG_BT_DIS_SERIAL_NUMBER=n
CONFIG_BT_DIS_FW_REV=y
CONFIG_BT_DIS_HW_REV=n
CONFIG_BT_DIS_SW_REV=n
CONFIG_BT_DIS_FW_REV_STR="0.1.0"
# CONFIG_BT_DIS_SERIAL_NUMBER_STR="0.0.0"
# CONFIG_BT_DIS_HW_REV_STR="0.0.0"
# CONFIG_BT_DIS_SW_REV_STR="0.0.0"
CONFIG_BT_DIS_SETTINGS=y
CONFIG_BT_DIS_STR_MAX=21

# Buffer Configuration
CONFIG_BT_L2CAP_TX_MTU=247
CONFIG_BT_BUF_ACL_RX_SIZE=251
CONFIG_BT_BUF_ACL_TX_SIZE=251
CONFIG_BT_BUF_ACL_TX_COUNT=6

# Connection Parameters
CONFIG_BT_PERIPHERAL_PREF_MIN_INT=6
CONFIG_BT_PERIPHERAL_PREF_MAX_INT=12
CONFIG_BT_PERIPHERAL_PREF_LATENCY=0
CONFIG_BT_PERIPHERAL_PREF_TIMEOUT=400

# If not set BT_SMP &  BT_SIGNING, the device will not be able to pair with other devices.
CONFIG_BT_SMP=y
CONFIG_BT_SIGNING=y
CONFIG_BT_BONDABLE=y
CONFIG_BT_KEYS_OVERWRITE_OLDEST=y
CONFIG_BT_PRIVACY=y

# Extended Advertising
CONFIG_BT_EXT_ADV=y
CONFIG_BT_CTLR_ADV_EXT=y

# Settings Subsystem
CONFIG_SETTINGS=y
CONFIG_BT_SETTINGS=y

# System Work Queue Configuration - Increased for input event handling
CONFIG_SYSTEM_WORKQUEUE_STACK_SIZE=32768
CONFIG_SYSTEM_WORKQUEUE_PRIORITY=-1

# Input Subsystem Configuration - Disable input warnings
CONFIG_INPUT=y
CONFIG_INPUT_LOG_LEVEL_OFF=y
CONFIG_I2C_LOG_LEVEL_OFF=y

# Flash Configurations
CONFIG_FLASH=y
CONFIG_FLASH_MAP=y
CONFIG_NVS=y

# Counter (using correct config name)
CONFIG_COUNTER=y

# Watchdog Timer
CONFIG_WATCHDOG=y
```

## src/main.c
```c
/** Main application entry point for Zephyr-based smartwatch firmware.
 * Initializes display, Bluetooth, timers, and manages the core watch functionality including time tracking and UI updates.
 * Now includes notification testing functionality and proper BLE initialization.
 *
 * @license GNU v3
 * @maintainer electricalgorithm @ github
 */

#include <stdio.h>

#include <zephyr/kernel.h>
#include <zephyr/logging/log.h>

#include "bluetooth/infrastructure.h"
#include "bluetooth/services/notifications.h"
#include "datetime/datetime.h"
#include "devicetwin/devicetwin.h"
#include "display/display.h"
#include "userinterface/userinterface.h"
#include "watchdog/watchdog.h"

// Define the logger.
LOG_MODULE_REGISTER(ZephyrWatch, LOG_LEVEL_INF);

#define SLEEP_UI_STABILIZE_MS 2000
#define SLEEP_MAIN_CORE_MS 20

// Setting for device's time zone.
int8_t utc_zone = +2;

/* ADD FUNCTION DECLARATION HERE */
int bluetooth_infrastructure_init(void);

static void notification_received_callback(const notification_t* notif)
{
    LOG_INF("New notification: %s from %s", notif->title, notif->app_name);
}

int main(void)
{
    int ret;

    // Set-up watchdog before all the subsystems.
    ret = enable_watchdog_subsystem();
    if (ret) {
        LOG_ERR("Watchdog subsystem couldn't be enabled. (RET: %d)", ret);
        return ret;
    }
    LOG_INF("Watchdog system is enabled.");

    /* ADD BLE INFRASTRUCTURE INIT HERE - Initialize BLE mutex early */
    ret = bluetooth_infrastructure_init();
    if (ret) {
        LOG_ERR("Bluetooth infrastructure couldn't be initialized. (RET: %d)", ret);
        return ret;
    }
    LOG_INF("Bluetooth infrastructure initialized.");

    // Create the device twin.
    device_twin_t* device_twin = create_device_twin_instance(0, utc_zone);
    if (!device_twin) {
        LOG_ERR("Cannot create device twin instance.");
        return 0;
    }
    LOG_INF("Device twin instance created successfully.");

    // Init the display subsystem.
    ret = enable_display_subsystem();
    if (ret) {
        LOG_ERR("Display subsystem couldn't enabled. (RET: %d)", ret);
        return ret;
    }
    LOG_INF("Display subsystem is enabled.");

    // Initialize the display device with initial user interface.
    user_interface_init();
    LOG_INF("User interface subsystem is enabled.");

    // Refresh the UI.
    user_interface_task_handler();
    LOG_INF("User interface is refreshed initially.");

    // Enable datetime subsystem.
    ret = enable_datetime_subsystem();
    if (ret) {
        LOG_ERR("Datetime subsystem couldn't enabled. (RET: %d)", ret);
        return ret;
    }
    LOG_INF("Datetime subsystem is enabled.");

    // Initialize the Bluetooth stack.
    // Give the system more time to stabilize before initializing Bluetooth.
    k_sleep(K_MSEC(SLEEP_UI_STABILIZE_MS));
    ret = enable_bluetooth_subsystem();
    if (ret) {
        LOG_ERR("Bluetooth subsystem couldn't enabled. (RET: %d)", ret);
        return ret;
    }
    LOG_INF("Bluetooth subsystem is enabled.");

    // Init notification service
    ret = notifications_init();
    if (ret) {
        LOG_ERR("Notifications service couldn't be initialized. (RET: %d)", ret);
        return ret;
    }

    ret = notifications_start();
    if (ret) {
        LOG_ERR("Notifications service couldn't be started. (RET: %d)", ret);
        return ret;
    }

    notifications_set_callback(notification_received_callback);
    LOG_INF("Notification service is enabled.");

    while (1) {
        user_interface_task_handler();
        k_sleep(K_MSEC(SLEEP_MAIN_CORE_MS));

        // Kick the watchdog.
        kick_watchdog();
    }
}
```
